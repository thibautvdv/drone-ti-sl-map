# CC2538NF53 register map
File version: 1.0
CPU: CM3 1.0, other endian, MPU, FPU, 3 interrupt priority bits
Registers are 32-bit, read-write, reset 0x0 unless marked. A register's access mark holds for its fields unless they carry their own. Offsets are from the block's base; [hi:lo] are bit positions; {n}, {i} and the like mark numbered series.

## RFCORE_FFSM — Register fields should be considered static unless otherwise noted as dynamic.
Base 0x40088500
0x80 SRCRESMASK0 — Source address matching result This register is stored in RAM; the reset value is undefined.
  [7:0] SRCRESMASK0 — [7:0] Extended address matching When there is a match on entry ext_n, bits 2n and 2n + 1 are set in SRCRESMASK.
0x84 SRCRESMASK1 — Source address matching result This register is stored in RAM; the reset value is undefined.
  [7:0] SRCRESMASK1 — [7:0] Short address matching When there is a match on entry panid_n + short_n, bit n is set in SRCRESMASK.
0x88 SRCRESMASK2 — Source address matching result This register is stored in RAM; the reset value is undefined.
  [7:0] SRCRESMASK2 — [7:0] 24-bit mask that indicates source address match for each individual entry in the source address table
0x8C SRCRESINDEX — Source address matching result This register is stored in RAM; the reset value is undefined.
  [7:0] SRCRESINDEX — [7:0] The bit index of the least-significant entry (0-23 for short addresses or 0-11 for extended addresses) in SRCRESMASK, or 0x3F when there is no source match On a match, bit 5 is 0 when the match is on a short address and 1 when it is on an extended address. On a match, bit 6 is 1 when the conditions for automatic pending bit in acknowledgment have been met (see the description of SRCMATCH.AUTOPEND). The bit does not indicate if the acknowledgment is actually transmitted, and does not consider the PENDING_OR register bit and the SACK/SACKPEND/SNACK strobes.
0x90 SRCEXTPENDEN0 — Source address matching control This register is stored in RAM; the reset value is undefined.
  [7:0] SRCEXTPENDEN0 — [7:0] 8 LSBs of the 24-bit mask that enables or disables automatic pending for each of the 12 extended addresses. Entry n is mapped to SRCEXTPENDEN[2n]. All SRCEXTPENDEN[2n + 1] bits are don't care.
0x94 SRCEXTPENDEN1 — Source address matching control This register is stored in RAM; the reset value is undefined.
  [7:0] SRCEXTPENDEN1 — [7:0] 8 middle bits of the 24-bit mask that enables or disables automatic pending for each of the 12 extended addresses Entry n is mapped to SRCEXTPENDEN[2n]. All SRCEXTPENDEN[2n + 1] bits are don't care.
0x98 SRCEXTPENDEN2 — Source address matching control This register is stored in RAM; the reset value is undefined.
  [7:0] SRCEXTPENDEN2 — [7:0] 8 MSBs of the 24-bit mask that enables or disables automatic pending for each of the 12 extended addresses Entry n is mapped to SRCEXTPENDEN[2n]. All SRCEXTPENDEN[2n + 1] bits are don't care.
0x9C SRCSHORTPENDEN0 — Source address matching control This register is stored in RAM; the reset value is undefined.
  [7:0] SRCSHORTPENDEN0 — [7:0] 8 LSBs of the 24-bit mask that enables or disables automatic pending for each of the 24 short addresses
0xA0 SRCSHORTPENDEN1 — Source address matching control This register is stored in RAM; the reset value is undefined.
  [7:0] SRCSHORTPENDEN1 — [7:0] 8 middle bits of the 24-bit mask that enables or disables automatic pending for each of the 24 short addresses
0xA4 SRCSHORTPENDEN2 — Source address matching control This register is stored in RAM; the reset value is undefined.
  [7:0] SRCSHORTPENDEN2 — [7:0] 8 MSBs of the 24-bit mask that enables or disables automatic pending for each of the 24 short addresses
{0xA8+4i} EXT_ADDR{i} (i=0..7) — Local address information This register is stored in RAM; the reset value is undefined.
  [7:0] EXT_ADDR{i} — [7:0] EXT_ADDR[{8i+7}:{8i}] The IEEE extended address used during destination address filtering
0xC8 PAN_ID0 — Local address information This register is stored in RAM; the reset value is undefined.
  [7:0] PAN_ID0 — [7:0] PAN_ID[7:0] The PAN ID used during destination address filtering
0xCC PAN_ID1 — Local address information This register is stored in RAM; the reset value is undefined.
  [7:0] PAN_ID1 — [7:0] PAN_ID[15:8] The PAN ID used during destination address filtering
0xD0 SHORT_ADDR0 — Local address information This register is stored in RAM; the reset value is undefined.
  [7:0] SHORT_ADDR0 — [7:0] SHORT_ADDR[7:0] The short address used during destination address filtering
0xD4 SHORT_ADDR1 — Local address information This register is stored in RAM; the reset value is undefined.
  [7:0] SHORT_ADDR1 — [7:0] SHORT_ADDR[15:8] The short address used during destination address filtering
